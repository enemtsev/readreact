## CMakeLists.txt
```
cmake_minimum_required(VERSION 3.20.0)

set(CMAKE_VERBOSE_MAKEFILE ON)
set(CMAKE_CXX_STANDARD 20)
set(BOARD native_sim)


find_package(Zephyr REQUIRED HINTS $ENV{ZEPHYR_BASE})
project(readreact)

# Add application sources
add_subdirectory(src)

if(NOT TEST_BUILD)
# Create the main executable
    target_sources(app PRIVATE src/main.cpp)
    target_link_libraries(app PRIVATE app_obj zephyr_interface)
else()
    add_subdirectory(tests)
endif()
```

## prj.conf
```kconfig
CONFIG_GPIO=y
CONFIG_GPIO_GET_CONFIG=y

CONFIG_ZBUS=y
CONFIG_LOG=y

CONFIG_CBPRINTF_FP_SUPPORT=y
CONFIG_ZBUS_CHANNEL_NAME=y
CONFIG_ZBUS_RUNTIME_OBSERVERS=y

CONFIG_STD_CPP20=y
CONFIG_TEST=y
CONFIG_CPP=y

CONFIG_GPIO_EMUL=y

CONFIG_POSIX_API=y

CONFIG_GLIBCXX_LIBCPP=y
CONFIG_NEWLIB_LIBC=y
CONFIG_MINIMAL_LIBC=n
CONFIG_PICOLIBC=n
CONFIG_EXTERNAL_LIBC=y

CONFIG_REQUIRES_FULL_LIBCPP=y
```

## boards/native_posix_64.overlay
```dts
/ {
    aliases {
        input-gpio = &gpio0;
        output-gpio = &gpio0;
    };

    gpio0: gpio0 {
        compatible = "zephyr,gpio-emul";
        status = "okay";
        ngpios = <32>;
    };
};
```

## boards/native_sim.overlay
```dts
/ {
    aliases {
        input-gpio = &gpio0_emul;
        output-gpio = &gpio1_emul;
    };

    gpio0_emul: gpio0 {
        compatible = "zephyr,gpio-emul";
        status = "okay";
        gpio-controller;
        #gpio-cells = <2>;
    };

    gpio1_emul: gpio1 {
        compatible = "zephyr,gpio-emul";
        status = "okay";
        gpio-controller;
        #gpio-cells = <2>;
    };
};
```

## boards/native_sim_64.overlay
```dts
/ {
	gpio_emul: gpio_emul {
		status = "okay";
		compatible = "zephyr,gpio-emul";
		rising-edge;
		falling-edge;
		high-level;
		low-level;
		gpio-controller;
		#gpio-cells = < 0x2 >;
		phandle = < 0x1 >;
	};

	resources {
		compatible = "test-gpio-basic-api";
		out-gpios = <&gpio0 0 0>; /* Pin 0 */
		in-gpios = <&gpio0 1 0>; /* Pin 1 */
	};
};

&gpio0 {
	ngpios = <2>;
};
```

## dts/bindings/test-gpio-basic-api.yaml
```yaml
description: |
    This binding provides resources required to build and run

compatible: "test-gpio-basic-api"

properties:
  out-gpios:
    type: phandle-array
    required: true
    description: |
      Identity of a GPIO that will be configured as an output.  This
      must be on the same device as in-gpios, and physically
      connected to in-gpios.

  in-gpios:
    type: phandle-array
    required: true
    description: |
      Identity of a GPIO that will be configured as an input.  This
      must be on the same device as out-gpios,and physically
      connected to out-gpios.
```

## src/main.cpp
```c
#include <zephyr/drivers/gpio.h>
#include <zephyr/drivers/gpio/gpio_emul.h>
#include <zephyr/kernel.h>
#include <zephyr/logging/log.h>
#include <zephyr/zbus/zbus.h>

#include "readreact/gpio_device.h"
#include "readreact/reactclass.h"
#include "readreact/reactled.h"
#include "readreact/readclass.h"
#include "readreact/zbusmanager.h"

LOG_MODULE_REGISTER(main, LOG_LEVEL_DBG);

ZBusManager *zbusmanager_ptr;

// Define ZBus channel
ZBUS_CHAN_DEFINE(gpio_state_change_chan, struct ZBusMessage, NULL, &zbusmanager_ptr, ZBUS_OBSERVERS(), {});

int main(void) {
    ZBusManager manager;
    zbusmanager_ptr = &manager;
    manager.set_channel(&gpio_state_change_chan);

    ReactLED react_led;
    ReactClass reactor(&react_led);

    ReadClass reader;

    manager.register_publisher(&reader);
    manager.register_subscriber(&reactor);

    // emulate loop
    const device *gpio_dev = DEVICE_DT_GET(DEV_GPIO);
    int state{0};

    while (1) {
        k_sleep(K_MSEC(1000));

        if (state) {
            gpio_emul_input_set(gpio_dev, PIN_IN, 0);
            state = 0;
        } else {
            gpio_emul_input_set(gpio_dev, PIN_IN, 1);
            state = 1;
        }
    }

    return 0;
}
```

## src/reactclass.cpp
```c
#include "readreact/reactclass.h"

#include <zephyr/kernel.h>
#include <zephyr/logging/log.h>
#include <zephyr/zbus/zbus.h>

LOG_MODULE_REGISTER(react);

ReactClass::ReactClass(ReactLED *react_led)
    : react_led_(react_led) {
    init();  // Initialize the GPIO and work structures.
}

// Initialize the GPIO, work structures, and setup the observer
void ReactClass::init() {
    react_led_->init();
    work_context_.react_ = this;
    k_work_init_delayable(&work_context_.blink_work_, blink_work_callback);
    LOG_INF("ReactClass initialized for output");
}

// This method overrides the handle_message() from BaseSubscriber
void ReactClass::handle_message(const struct ZBusMessage &msg) {
    last_state_ = msg.state;
    k_work_schedule(&work_context_.blink_work_, K_NO_WAIT);
}

// This function is called by the work manager for blinking the LED.
void ReactClass::blink_work_callback(struct k_work *work) {
    k_work_delayable *dwork = k_work_delayable_from_work(work);
    WorkContext *ctx = CONTAINER_OF(dwork, WorkContext, blink_work_);

    if (ctx->react_->last_state_) {  // If state is HIGH
        // Blink the LED 3 times with 100ms delay
        for (int i = 0; i < 3; ++i) {
            ctx->react_->react_led_->turn_on();
            k_sleep(K_MSEC(100));
            ctx->react_->react_led_->turn_off();
            k_sleep(K_MSEC(100));
        }
    } else {  // If state is LOW
        // Keep the LED on for 500ms
        ctx->react_->react_led_->turn_on();
        k_sleep(K_MSEC(500));
        ctx->react_->react_led_->turn_off();
    }
}
```

## src/reactled.cpp
```c
#include "readreact/reactled.h"
#include "readreact/gpio_device.h"

#include <zephyr/kernel.h>
#include <zephyr/logging/log.h>

LOG_MODULE_REGISTER(reactled);

bool ReactLED::init() {
    pin_ = PIN_OUT;
    gpio_dev_ = DEVICE_DT_GET(DEV_GPIO);
    if (!device_is_ready(gpio_dev_)) {
        LOG_ERR("Output GPIO device not ready");
        return false;
    }

    int ret = gpio_pin_configure(gpio_dev_, pin_, DEV_OUT_CONFIG);
    if (ret < 0) {
        LOG_ERR("Failed to configure output GPIO: %d", ret);
        return false;
    }

    return true;
}

void ReactLED::turn_on() {
    LOG_INF("LED on");
    if (gpio_dev_ != nullptr) {
        gpio_pin_set(gpio_dev_, pin_, 1);
    } else {
        LOG_ERR("LED device error");
    }
}

void ReactLED::turn_off() {
    LOG_INF("LED off");
    if (gpio_dev_ != nullptr) {
        gpio_pin_set(gpio_dev_, pin_, 0);
    } else {
        LOG_ERR("LED device error");
    }
}
```

## src/readclass.cpp
```c
#include "readreact/readclass.h"
#include "readreact/gpio_device.h"

#include <zephyr/logging/log.h>
#include <zephyr/sys_clock.h>
#include <gmock/gmock.h>
#include <zephyr/drivers/gpio.h>

LOG_MODULE_REGISTER(read, LOG_LEVEL_DBG);

ReadClass::ReadClass() {
    callback_context_.read_ = this;
    work_context_.read_ = this;

    k_work_init_delayable(&work_context_.work_, work_callback);
}

ReadClass::~ReadClass() {
    k_work_cancel_delayable(&work_context_.work_);
    gpio_remove_callback(gpio_dev_, &callback_context_.callback_);
}

bool ReadClass::init_gpio_device() {
    if (!device_is_ready(gpio_dev_)) {
        LOG_ERR("Input GPIO device not ready");
        return false;
    }

    int ret = gpio_pin_configure(gpio_dev_, pin_, flags_);
    if (ret < 0) {
        LOG_ERR("Failed to configure input GPIO: %d", ret);
        return false;
    }

    ret = gpio_pin_interrupt_configure(gpio_dev_, pin_, GPIO_INT_EDGE_BOTH);
    if (ret < 0) {
        LOG_ERR("Failed to configure interrupt: %d", ret);
        return false;
    }

    gpio_init_callback(&callback_context_.callback_, interrupt_callback, BIT(pin_));

    ret = gpio_add_callback(gpio_dev_, &callback_context_.callback_);
    if (ret < 0) {
        LOG_ERR("Failed to add callback: %d", ret);
        return false;
    }

    return true;
}

bool ReadClass::init() {
    gpio_dev_ = DEVICE_DT_GET(DEV_GPIO);
    pin_ = PIN_IN;
    flags_ = DEV_IN_CONFIG;

    bool ret = init_gpio_device();

    LOG_INF("ReadClass initialized for input pin %d", ret);
    
    return ret;
}

void ReadClass::interrupt_callback(const device *dev, gpio_callback *cb, uint32_t pins) {
    CallbackContext *ctx = CONTAINER_OF(cb, CallbackContext, callback_);
    k_work_schedule(&ctx->read_->work_context_.work_, K_NO_WAIT);
}

void ReadClass::work_callback(struct k_work *work) {
    k_work_delayable *dwork = k_work_delayable_from_work(work);
    WorkContext *ctx = CONTAINER_OF(dwork, WorkContext, work_);
    ctx->read_->process_gpio_change();
}

void ReadClass::process_gpio_change() {
    int state = gpio_pin_get(gpio_dev_, pin_);
    int64_t time = k_uptime_get() - last_change_time_;
    LOG_DBG("process_gpio_change state: %d %d", state, time);
    
    if (time > DEBOUNCE_TIME_MS && state != last_state_) {
        last_state_ = state;
        last_change_time_ = k_uptime_get();

        ZBusMessage msg = {static_cast<bool>(state)};
        publish(msg);  // Use BasePublisher's publish function

        LOG_INF("GPIO state changed to %s", state ? "HIGH" : "LOW");
    }
}
```

## src/zbusmanager.cpp
```c
#include "readreact/zbusmanager.h"
#include <zephyr/logging/log.h>

LOG_MODULE_REGISTER(zbus_manager, LOG_LEVEL_INF);

ZBUS_LISTENER_DEFINE(zbusmanager_observer, ZBusManager::channel_callback);

void ZBusManager::channel_callback(const struct zbus_channel *chan) {
    auto *manager = *static_cast<ZBusManager **>(chan->user_data);
    if (!manager)
        return;

    const ZBusMessage *message = static_cast<const ZBusMessage *>(zbus_chan_const_msg(chan));
    for (auto *subscriber : manager->subscribers_) {
        subscriber->handle_message(*message);
    }
}

ZBusManager::~ZBusManager() {
    zbus_chan_rm_obs(channel_, &zbusmanager_observer, K_NO_WAIT);
}

void ZBusManager::register_publisher(BasePublisher *publisher) {
    publisher->init();
    publishers_.push_back(publisher);
    publisher->set_publish_callback([this](const ZBusMessage &message) {
        this->publish(message);
    });
}

void ZBusManager::register_subscriber(BaseSubscriber *subscriber) {
    subscribers_.push_back(subscriber);
}

void ZBusManager::publish(const ZBusMessage &message) {
    zbus_chan_pub(channel_, &message, K_NO_WAIT);
}

void ZBusManager::set_channel(const struct zbus_channel *chan) {
    channel_ = chan;
    zbus_chan_add_obs(channel_, &zbusmanager_observer, K_NO_WAIT);
}
```
